## boards/esp32-heltec-lora32-v3/Kconfig
```kconfig
# SPDX-FileCopyrightText: 2020 HAW Hamburg
# SPDX-License-Identifier: LGPL-2.1-only

config BOARD
    default "esp32-heltec-lora32-v3" if BOARD_ESP32_HELTEC_LORA32_V3

config BOARD_ESP32_HELTEC_LORA32_V3
    bool
    default y
    select BOARD_COMMON_ESP32S3
    select CPU_MODEL_ESP32S3

source "$(RIOTBOARD)/common/esp32s3/Kconfig"
```
